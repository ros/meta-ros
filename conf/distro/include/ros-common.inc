## meta-ros2/conf/distro/include/ros2-sdk.inc
```bitbake
# Copyright (c) 2024 Qualcomm Innovation Center, Inc. All rights reserved

# native packages in SDK
TOOLCHAIN_HOST_TASK:append = " \
    nativesdk-ament-package \
    nativesdk-python3-colcon-common-extensions \
    nativesdk-python3-numpy \
    nativesdk-rosidl-adapter \
    nativesdk-rosidl-cli \
    nativesdk-rosidl-cmake \
    nativesdk-rosidl-generator-c \
    nativesdk-rosidl-generator-cpp \
    nativesdk-rosidl-parser \
    nativesdk-rosidl-typesupport-c \
    nativesdk-rosidl-typesupport-cpp \
    nativesdk-rosidl-typesupport-fastrtps-c \
    nativesdk-rosidl-typesupport-fastrtps-cpp \
    nativesdk-rosidl-typesupport-introspection-c \
    nativesdk-rosidl-typesupport-introspection-cpp \
"

# target packages in SDK
TOOLCHAIN_TARGET_TASK:append = " \
    ament-cmake \
    ament-cmake-auto \
    ament-cmake-core \
    ament-cmake-export-definitions \
    ament-cmake-export-dependencies \
    ament-cmake-export-include-directories \
    ament-cmake-export-interfaces \
    ament-cmake-export-libraries \
    ament-cmake-export-link-flags \
    ament-cmake-export-targets \
    ament-cmake-gen-version-h \
    ament-cmake-gmock \
    ament-cmake-google-benchmark \
    ament-cmake-gtest \
    ament-cmake-include-directories \
    ament-cmake-libraries \
    ament-cmake-nose \
    ament-cmake-pytest \
    ament-cmake-python \
    ament-cmake-ros \
    ament-cmake-target-dependencies \
    ament-cmake-test \
    ament-cmake-version \
    ament-lint-auto \
    foonathan-memory-staticdev \
"
```

## meta-ros2/conf/distro/ros2.conf
```bitbake
# Copyright (c) 2019-2021 LG Electronics, Inc.

DISTRO_NAME = "Robot Operating System 2 (ROS 2)"

require conf/distro/include/ros-common.inc
```

## meta-spaceros/conf/distro/spaceros.conf
```bitbake
# Copyright (c) 2019-2021 LG Electronics, Inc.

DISTRO_NAME = "Space ROS"

require conf/distro/ros2.conf
```

## meta-spaceros/conf/layer.conf
```bitbake
# We have a conf and classes directory, append to BBPATH
BBPATH .= ":${LAYERDIR}"

# We have a recipes directory, add to BBFILES
BBFILES += "${LAYERDIR}/recipes-*/*/*.bb ${LAYERDIR}/recipes-*/*/*.bbappend"

BBFILE_COLLECTIONS += "spaceros-layer"
BBFILE_PATTERN_spaceros-layer := "^${LAYERDIR}/"
BBFILE_PRIORITY_spaceros-layer = "11"

# Version 1 was the manually created meta-ros, prior to the introduction of superflore.
# Version 2 was all ROS distributions in the same meta-ros layer with right subdirectories selected by ROS_DISTRO variable
# Version 3 is with each ROS distribution in separate sublayer of meta-ros git repository (with modifications to generated recipes applied in .bbappends instead of .inc files)
LAYERVERSION_spaceros-layer = "3"

LAYERDEPENDS_spaceros-layer = " \
    core \
    meta-python \
    openembedded-layer \
    ros-common-layer \
    ros2-layer \
"

LAYERSERIES_COMPAT_spaceros-layer = "whinlatter"

ROS_OE_DISTRO_NAME ?= "Space ROS"
```

## meta-webos-ros/conf/layer.conf
```bitbake
# We have a conf and classes directory, append to BBPATH
BBPATH .= ":${LAYERDIR}"

# We have a recipes directory, add to BBFILES
BBFILES += "${LAYERDIR}/recipes-*/*/*.bb ${LAYERDIR}/recipes-*/*/*.bbappend"

BBFILE_COLLECTIONS += "meta-webos-ros"
BBFILE_PATTERN_meta-webos-ros := "^${LAYERDIR}/"
BBFILE_PRIORITY_meta-webos-ros = "52"

# Version 1 was the manually created meta-ros, prior to the introduction of superflore.
# Version 2 was all ROS distributions in the same meta-ros layer with right subdirectories selected by ROS_DISTRO variable
# Version 3 is with each ROS distribution in separate sublayer of meta-ros git repository (with modifications to generated recipes applied in .bbappends instead of .inc files)
LAYERVERSION_meta-webos-ros = "3"

LAYERDEPENDS_meta-webos-ros = " \
    core \
    meta-python \
    openembedded-layer \
    ros-common-layer \
"

LAYERSERIES_COMPAT_meta-webos-ros = "thud"
```
