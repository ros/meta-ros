## conf/distro/include/ros-common.inc
```bitbake
# OE DISTRO configuration settings common to both ROS 1 and ROS 2 distros.
#
# Copyright (c) 2019 LG Electronics, Inc.

DISTRO_CODENAME = "${ROS_DISTRO}"
DISTRO_VERSION = "${ROS_DISTRO_METADATA_VERSION}"

MAINTAINER = "Herb Kuta <herb.kuta@lge.com>"
```

## conf/distro/ros2.conf
```bitbake
# Copyright (c) 2019 LG Electronics, Inc.

DISTRO_NAME = "Robot Operating System 2 (ROS 2)"

require conf/distro/include/ros-common.inc

PNBLACKLIST[python] ?= "ROS 2 is Python 3 only"
```

## conf/layer.conf
```bitbake
# We have a conf and classes directory, append to BBPATH
BBPATH .= ":${LAYERDIR}"

# We have a recipes directory, add to BBFILES
BBFILES += "${LAYERDIR}/recipes-*/*/*.bb ${LAYERDIR}/recipes-*/*/*.bbappend"

BBFILE_COLLECTIONS += "ros-layer"
BBFILE_PATTERN_ros-layer := "^${LAYERDIR}/"
BBFILE_PRIORITY_ros-layer = "7"

LICENSE_PATH += "${LAYERDIR}/licenses"

# Version 1 was the manually created meta-ros, prior to the introduction of superflore.
LAYERVERSION_ros-layer = "2"

LAYERDEPENDS_ros-layer = " \
    core \
    meta-python \
    openembedded-layer \
"

# We only need meta-qt5 if Qt5 has been enabled.
LAYERDEPENDS_ros-layer += "${@bb.utils.contains('DISTRO_FEATURES', 'ros-qt5', 'qt5-layer', '', d)}"

# We only need meta-intel-realsense if RealSense has been enabled.
LAYERDEPENDS_ros-layer += "${@bb.utils.contains('DISTRO_FEATURES', 'ros-realsense', 'intel-realsense', '', d)}"

require conf/ros-distro/ros-distro.conf

# Only .bb files are generated
BBFILES += "${LAYERDIR}/generated-recipes-${ROS_DISTRO}/*/*.bb"

# This is only temporary: in layer version 3, this will be resolved in .bbappend-s
# and reported upstream like:
# https://github.com/ANYbotics/rqt_multiplot_plugin/issues/35
# https://github.com/ANYbotics/variant-release/issues/1
# https://github.com/orocos/orocos-kdl-release/issues/4
# https://github.com/ros2-gbp/orocos_kinematics_dynamics-release/issues/2
# https://github.com/ros-perception/slam_karto/issues/28
# https://github.com/SteveMacenski/navigation2-release/issues/1
# Be aware that this isn't accurate or even correct, some of these actually have
# e.g. LGPL-3.0, Apache-2, BSD, CC-BY-* licenses instead
SPDXLICENSEMAP[LGPL-2] = "LGPL-2.0"
```

## kas/Kconfig
```kconfig
mainmenu "meta-ros Image configuration"

menu "Yocto build options"

    choice
        prompt "Select machine"
        default MACHINE_QEMUX86

        config MACHINE_QEMUX86
            bool "qemux86-64"

        config MACHINE_RPI4
            bool "raspberrypi4-64"

        config MACHINE_RPI5
            bool "raspberrypi5"
    endchoice

    choice
        prompt "Select Yocto release"
        default YOCTO_RELEASE_MASTER

        config YOCTO_RELEASE_MASTER
            bool "master"

        config YOCTO_RELEASE_WALNASCAR
            bool "walnascar"
	    help
	        5.2
		
        config YOCTO_RELEASE_STYHEAD
            bool "styhead"
	    help
	        5.1 (EOL)

        config YOCTO_RELEASE_SCARTHGAP
            bool "scarthgap"
	    help
	        5.0 LTS

        config YOCTO_RELEASE_MICKLEDORE
            bool "mickledore"
	    help
	        4.2 (EOL)

        config YOCTO_RELEASE_KIRKSTONE
            bool "kirkstone"
	    help
	        4.0 LTS

    endchoice

endmenu

menu "ROS build options"
    choice
        prompt "Select ROS release"
        default ROS_RELEASE_ROLLING

        config ROS_RELEASE_ROLLING
            bool "rolling"

        config ROS_RELEASE_KILTED
            bool "kilted"
	    help
	        ROS2 Kilted Kaiju

        config ROS_RELEASE_JAZZY
            bool "jazzy"
	    help
	        ROS2 Jazzy Jalisco

        config ROS_RELEASE_HUMBLE
            bool "humble"
	    help
	        ROS2 Humble Hawksbill

        config ROS_RELEASE_NOETIC
            bool "noetic"
	    help
	        ROS Noetic Ninjemys

    endchoice

endmenu

menu "ROS image"
    choice
        prompt "Select ROS image"
	default ROS_IMAGE_CORE

        config ROS_IMAGE_CORE
	    bool "ros-image-core"

        config ROS_IMAGE_WORLD
	    bool "ros-image-world"

        config ROS_IMAGE_DESKTOP
	    bool "ros-image-desktop"
    endchoice	    
endmenu

config KAS_TARGET_CHOICE
    string
    default "ros-image-core" if ROS_IMAGE_CORE
    default "ros-image-world" if ROS_IMAGE_WORLD
    default "ros-image-desktop" if ROS_IMAGE_DESKTOP

config KAS_INCLUDE_YOCTO_RELEASE
    string
    default "kas/yocto/master.yml" if YOCTO_RELEASE_MASTER
    default "kas/yocto/walnascar.yml" if YOCTO_RELEASE_WALNASCAR
    default "kas/yocto/styhead.yml" if YOCTO_RELEASE_STYHEAD
    default "kas/yocto/scarthgap.yml" if YOCTO_RELEASE_SCARTHGAP
    default "kas/yocto/mickledore.yml" if YOCTO_RELEASE_MICKLEDORE
    default "kas/yocto/kirkstone.yml" if YOCTO_RELEASE_KIRKSTONE

config KAS_INCLUDE_ROS_RELEASE
    string
    default "kas/ros2/rolling.yml" if ROS_RELEASE_ROLLING
    default "kas/ros2/kilted.yml" if ROS_RELEASE_KILTED
    default "kas/ros2/jazzy.yml" if ROS_RELEASE_JAZZY
    default "kas/ros2/humble.yml" if ROS_RELEASE_HUMBLE
    default "kas/ros1/noetic.yml" if ROS_RELEASE_NOETIC

config KAS_INCLUDE_MACHINE
    string
    default "kas/machine/qemux86-64.yml" if MACHINE_QEMUX86
    default "kas/machine/raspberrypi4-64.yml" if MACHINE_RPI4
    default "kas/machine/raspberrypi5.yml" if MACHINE_RPI5


config KAS_INCLUDE_COMMON
    string
    default "kas/common.yml"

config KAS_INCLUDE_SYSTEMD
    string
    default "kas/systemd.yml"

config KAS_INCLUDE_VISIALIZATION
    string
    default "kas/visualization.yml"
    depends on ROS_IMAGE_DESKTOP

config KAS_MACHINE
    string
    default "qemux86-64" if MACHINE_QEMUX86
    default "raspberrypi4-64" if MACHINE_RPI4
    default "raspberrypi5" if MACHINE_RPI5

config KAS_DISTRO
    string
    default "ros1" if ROS_RELEASE_NOETIC
    default "ros2"
```

## meta-ros-backports-gatesgarth/conf/layer.conf
```bitbake
# We have a conf and classes directory, append to BBPATH
BBPATH .= ":${LAYERDIR}"

# We have a recipes directory, add to BBFILES
BBFILES += "${LAYERDIR}/recipes-*/*/*.bb ${LAYERDIR}/recipes-*/*/*.bbappend"

BBFILE_COLLECTIONS += "ros-backports-gatesgarth-layer"
BBFILE_PATTERN_ros-backports-gatesgarth-layer := "^${LAYERDIR}/"
BBFILE_PRIORITY_ros-backports-gatesgarth-layer = "7"

# Version 1 was the manually created meta-ros, prior to the introduction of superflore.
# Version 2 was all ROS distributions in the same meta-ros layer with right subdirectories selected by ROS_DISTRO variable
# Version 3 is with each ROS distribution in separate sublayer of meta-ros git repository (with modifications to generated recipes applied in .bbappends instead of .inc files)
LAYERVERSION_ros-backports-gatesgarth-layer = "3"

LAYERDEPENDS_ros-backports-gatesgarth-layer = " \
    core \
    openembedded-layer \
"

LAYERSERIES_COMPAT_ros-backports-gatesgarth-layer = "${ROS_OE_RELEASE_SERIES}"
```

## meta-ros-backports-zeus/conf/layer.conf
```bitbake
# We have a conf and classes directory, append to BBPATH
BBPATH .= ":${LAYERDIR}"

# We have a recipes directory, add to BBFILES
BBFILES += "${LAYERDIR}/recipes-*/*/*.bb ${LAYERDIR}/recipes-*/*/*.bbappend"

BBFILE_COLLECTIONS += "ros-backports-zeus-layer"
BBFILE_PATTERN_ros-backports-zeus-layer := "^${LAYERDIR}/"
BBFILE_PRIORITY_ros-backports-zeus-layer = "8"

# Version 1 was the manually created meta-ros, prior to the introduction of superflore.
# Version 2 was all ROS distributions in the same meta-ros layer with right subdirectories selected by ROS_DISTRO variable
# Version 3 is with each ROS distribution in separate sublayer of meta-ros git repository (with modifications to generated recipes applied in .bbappends instead of .inc files)
LAYERVERSION_ros-backports-zeus-layer = "3"

LAYERDEPENDS_ros-backports-zeus-layer = " \
    core \
    meta-python \
    openembedded-layer \
"

LAYERSERIES_COMPAT_ros-backports-zeus-layer = "${ROS_OE_RELEASE_SERIES}"
```

## meta-ros-common/conf/distro/include/ros-common.inc
```bitbake
# OE DISTRO configuration settings common to both ROS 1 and ROS 2 distros.
#
# Copyright (c) 2019-2021 LG Electronics, Inc.

DISTRO_NAME = "${ROS_OE_DISTRO_NAME} with OpenEmbedded Linux"
DISTRO_CODENAME = "${ROS_DISTRO}"

ROS_DISTRO_VERSION_APPEND ??= ""
DISTRO_VERSION = "${ROS_DISTRO_METADATA_VERSION}${ROS_DISTRO_VERSION_APPEND}"

MAINTAINER = "Rob Woolley <rob.woolley@windriver.com>"

# Use systemd together with the udev device manager
# (see https://docs.yoctoproject.org/dev-manual/init-manager.html#using-systemd).
INIT_MANAGER = "systemd"

# Without this, networking has to be started manually.
ROS_CONNECTION_MANAGER ??= "connman"
IMAGE_INSTALL:append = " \
    ${ROS_CONNECTION_MANAGER} \
"
```

## meta-ros-common/conf/distro/include/ros-useful-buildcfg-vars.inc
```bitbake
# Copyright (c) 2019-2020 LG Electronics, Inc.
#
# Add INHERIT, DISTRO_FEATURES (without those that start with "libc-"), MACHINE_FEATURES, IMAGE_FEATURES, and, if it's not just
# whitespace, IMAGE_FSTYPES to what's shown as the build configuration by adding:
#
#   require conf/distro/include/ros-useful-buildcfg-vars.inc
#
# to your conf/local.conf .

# Note that d.getVar() returns None if the variable is unset, and NoneType doesn't have a .split().

DISTRO_FEATURES_NO_LIBC = "${@ ' '.join(sorted(set([f for f in (d.getVar('DISTRO_FEATURES') or '').split() if not f.startswith('libc-')]))) }"
ROS_EXTRA_BUILDCFG_VARS_append = " INHERIT DISTRO_FEATURES_NO_LIBC MACHINE_FEATURES IMAGE_FEATURES"

# Include LICENSE_FLAGS_WHITELIST unless it's unset or just whitespace.
ROS_EXTRA_BUILDCFG_VARS_append = "${@ ' LICENSE_FLAGS_WHITELIST' if len((d.getVar('LICENSE_FLAGS_WHITELIST') or '').split()) > 0 else '' }"

# Include IMAGE_FSTYPES unless it's unset or just whitespace.
ROS_EXTRA_BUILDCFG_VARS_append = "${@ ' IMAGE_FSTYPES' if len((d.getVar('IMAGE_FSTYPES') or '').split()) > 0 else '' }"
```

## meta-ros-common/conf/layer.conf
```bitbake
# We have a conf and classes directory, append to BBPATH
BBPATH .= ":${LAYERDIR}"

# We have a recipes directory, add to BBFILES
BBFILES += "${LAYERDIR}/recipes-*/*/*.bb ${LAYERDIR}/recipes-*/*/*.bbappend"

BBFILE_COLLECTIONS += "ros-common-layer"
BBFILE_PATTERN_ros-common-layer := "^${LAYERDIR}/"
BBFILE_PRIORITY_ros-common-layer = "7"

LICENSE_PATH += "${LAYERDIR}/licenses"

# Version 1 was the manually created meta-ros, prior to the introduction of superflore.
# Version 2 was all ROS distributions in the same meta-ros layer with right subdirectories selected by ROS_DISTRO variable.
# Version 3 is with each ROS distribution in separate sublayer of meta-ros git repository (with modifications to generated recipes
#   applied in .bbappends instead of .inc files).
LAYERVERSION_ros-common-layer = "3"

LAYERDEPENDS_ros-common-layer = " \
    core \
    meta-python \
    openembedded-layer \
    ros-backports-warrior-layer \
"

LAYERSERIES_COMPAT_ros-common-layer = "${ROS_OE_RELEASE_SERIES}"

require conf/ros-distro/ros-distro.conf
```

## meta-ros-python2/conf/layer.conf
```bitbake
# We have a conf and classes directory, append to BBPATH
BBPATH .= ":${LAYERDIR}"

# We have a recipes directory, add to BBFILES
BBFILES += "${LAYERDIR}/recipes-*/*/*.bb ${LAYERDIR}/recipes-*/*/*.bbappend"

BBFILE_COLLECTIONS += "ros-python2"
BBFILE_PATTERN_ros-python2 := "^${LAYERDIR}/"
BBFILE_PRIORITY_ros-python2 = "7"

# Version 1 was the manually created meta-ros, prior to the introduction of superflore.
# Version 2 was all ROS distributions in the same meta-ros layer with right subdirectories selected by ROS_DISTRO variable
# Version 3 is with each ROS distribution in separate sublayer of meta-ros git repository (with modifications to generated recipes applied in .bbappends instead of .inc files)
LAYERVERSION_ros-python2 = "3"

LAYERDEPENDS_ros-python2 = " \
    core \
    meta-python2 \
    openembedded-layer \
"

LAYERSERIES_COMPAT_ros-python2 = "${ROS_OE_RELEASE_SERIES}"
```

## meta-ros1-melodic/conf/layer.conf
```bitbake
# We have a conf and classes directory, append to BBPATH
BBPATH .= ":${LAYERDIR}"

# We have a recipes directory, add to BBFILES
BBFILES += "${LAYERDIR}/recipes-*/*/*.bb ${LAYERDIR}/recipes-*/*/*.bbappend ${LAYERDIR}/generated-recipes/*/*.bb"

BBFILE_COLLECTIONS += "ros1-melodic-layer"
BBFILE_PATTERN_ros1-melodic-layer := "^${LAYERDIR}/"
BBFILE_PRIORITY_ros1-melodic-layer = "7"

# Version 1 was the manually created meta-ros, prior to the introduction of superflore.
# Version 2 was all ROS distributions in the same meta-ros layer with right subdirectories selected by ROS_DISTRO variable
# Version 3 is with each ROS distribution in separate sublayer of meta-ros git repository (with modifications to generated recipes applied in .bbappends instead of .inc files)
LAYERVERSION_ros1-melodic-layer = "3"

LAYERDEPENDS_ros1-melodic-layer = " \
    core \
    meta-python \
    meta-python2 \
    ros-python2 \
    openembedded-layer \
    ros-common-layer \
    ros1-layer \
"

LAYERSERIES_COMPAT_ros1-melodic-layer = "${ROS_OE_RELEASE_SERIES}"

require conf/ros-distro/include/melodic/ros-distro.inc
```

## meta-ros1/conf/distro/ros1.conf
```bitbake
# Copyright (c) 2019 LG Electronics, Inc.

DISTRO_NAME = "Robot Operating System (ROS)"

require conf/distro/include/ros-common.inc

# Unfortunately, opkg requires Python 3.
# SKIP_RECIPE[python3] ?= "Python 3 not supported for ROS 1"
```

## meta-ros2-rolling/conf/layer.conf
```bitbake
# We have a conf and classes directory, append to BBPATH
BBPATH .= ":${LAYERDIR}"

# We have a recipes directory, add to BBFILES
BBFILES += "${LAYERDIR}/recipes-*/*/*.bb ${LAYERDIR}/recipes-*/*/*.bbappend ${LAYERDIR}/generated-recipes/*/*.bb"

BBFILE_COLLECTIONS += "ros2-rolling-layer"
BBFILE_PATTERN_ros2-rolling-layer := "^${LAYERDIR}/"
BBFILE_PRIORITY_ros2-rolling-layer = "12"

# Version 1 was the manually created meta-ros, prior to the introduction of superflore.
# Version 2 was all ROS distributions in the same meta-ros layer with right subdirectories selected by ROS_DISTRO variable
# Version 3 is with each ROS distribution in separate sublayer of meta-ros git repository (with modifications to generated recipes applied in .bbappends instead of .inc files)
LAYERVERSION_ros2-rolling-layer = "3"

LAYERDEPENDS_ros2-rolling-layer = " \
    core \
    meta-python \
    openembedded-layer \
    ros-common-layer \
    ros2-layer \
"

LAYERSERIES_COMPAT_ros2-rolling-layer = "${ROS_OE_RELEASE_SERIES}"

require conf/ros-distro/include/rolling/ros-distro.inc
```
